## Kconfig
```kconfig
menu "My super zephyr module"

rsource "drivers/Kconfig"

rsource "subsys/Kconfig"

endmenu
```

## drivers/qspi_ram/Kconfig
```kconfig
config QSPI_RAM
    bool "enable QSPI RAM driver"

if QSPI_RAM

module = QSPI_RAM
module-str = qspi_ram
source "subsys/logging/Kconfig.template.log_config"

rsource "Kconfig.stm32"

endif
```

## drivers/qspi_ram/Kconfig.stm32
```kconfig
# MCP3424 I2C ADC configuation options

config QSPI_RAM_STM32
    bool "QSPI RAM driver"
    select USE_STM32_HAL_QSPI
```

## dts/bindings/qspi_ram/st,stm32-qspi-ram.yaml
```yaml
description: |
    STM32 QSPI RAM
    Representation of a serial flash on a quadspi bus:

        mx25r6435f: qspi-nor-flash@0 {
                compatible = "st,stm32-qspi-nor";
                label = "MX25R6435F";
                reg = <0>;
                qspi-max-frequency = <80000000>;
                size = <0x4000000>;
                status = "okay";
        };

compatible: "st,stm32-qspi-ram"

include: "base.yaml"

on-bus: qspi

properties:
    qspi-max-frequency:
      type: int
      required: true
      description: Maximum clock frequency of device's QSPI interface in Hz
    label:
      required: true
    size:
      type: int
      required: true
      description: Memory size in bits
    data-lines:
      type: int
      required: true
      description: Number of data lines (1,2,4 supported)
```

## subsys/ext_memc/Kconfig
```kconfig
config EXT_MEMC
    bool "enable external QSPI RAM memory controller"

if EXT_MEMC

module = EXT_MEMC
module-str = ext_memc
source "subsys/logging/Kconfig.template.log_config"

endif
```
